## config/west.yml
```yaml
manifest:
  remotes:
    - name: cormoran
      url-base: https://github.com/cormoran
    - name: badjeff
      url-base: https://github.com/badjeff
    - name: caksoylar
      url-base: https://github.com/caksoylar
  projects:
    # ZMK本体（DYA Studio対応のcormoran版）
    - name: zmk
      remote: cormoran
      revision: v0.3+custom-studio-protocol
      import: app/west.yml
    - name: zmk-pmw3610-driver
      remote: badjeff
      revision: zmk-0.3
    - name: zmk-rgbled-widget
      remote: caksoylar
      revision: v0.3-branch
    # DYA Studio用モジュール
    - name: zmk-module-runtime-input-processor
      remote: cormoran
      revision: dbf92f7
    - name: zmk-behavior-runtime-sensor-rotate
      remote: cormoran
      revision: main
  self:
    path: config
```
